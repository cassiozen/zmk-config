#include <dt-bindings/zmk/keys.h>

/ {
    kscan0: kscan {
        compatible = "zmk,kscan-gpio-direct";
        debounce_period = <5>;
        label = "KSCAN";
        gpios = <
            &pro_micro_d 2 GPIO_ACTIVE_HIGH
            &pro_micro_d 3 GPIO_ACTIVE_HIGH
            &pro_micro_d 4 GPIO_ACTIVE_HIGH
            &pro_micro_d 5 GPIO_ACTIVE_HIGH
            &pro_micro_d 6 GPIO_ACTIVE_HIGH
        >;
    };
};
